## myDrivers/Kconfig
```kconfig
#
# Bus Devices
#

menu "my drivers"
source "drivers/myDrivers/chMemMap/Kconfig"

#config ARM_CCI
#	bool
#	help
#	  zynq memory map driver.

endmenu
```

## myDrivers/chMemMap/Kconfig
```kconfig
#
# MyDriver 
#

config CHMEMMAP_DRIVER
	tristate "my character driver for memory map"
	help
	  Say yes here to enable the GPIO driver for the DA9052 chip.
```
